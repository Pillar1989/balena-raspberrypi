## layers/meta-balena-raspberrypi/conf/machine/seeed-recomputer-r2x.conf
```bitbake
#@TYPE: Machine
#@NAME: Seeed reComputer-R2x
#@SOC: broadcom bcm2712
#@DESCRIPTION: Machine configuration for seeed reComputer-R2x
#@MAINTAINER: ruiqian tang <ruiqian.tang@seeed.cc>

MACHINEOVERRIDES = "raspberrypi5:${MACHINE}"
include conf/machine/raspberrypi5.conf

RPI_KERNEL_DEVICETREE_OVERLAYS:append = " overlays/reComputer-R2x.dtbo overlays/i2c0.dtbo \ 
overlays/i2c1.dtbo overlays/i2c3.dtbo overlays/i2c6.dtbo"
KERNEL_MODULE_AUTOLOAD:rpi += "i2c-dev"
MACHINE_ESSENTIAL_EXTRA_RRECOMMENDS += "recomputer-r2x-detection"
ENABLE_I2C = "1"
ENABLE_UART = "1"
```
